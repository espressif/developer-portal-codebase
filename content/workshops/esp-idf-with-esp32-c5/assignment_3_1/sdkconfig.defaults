## content/workshops/esp-idf-with-esp32-c5/assignment_3_1/sdkconfig.defaults
```kconfig
CONFIG_PARTITION_TABLE_CUSTOM=y
CONFIG_PARTITION_TABLE_CUSTOM_FILENAME="partitions.csv"
CONFIG_PARTITION_TABLE_FILENAME="partitions.csv"
CONFIG_ESP_HTTPS_OTA_ALLOW_HTTP=y
```

## content/workshops/esp-idf-with-esp32-c5/assignment_3_2/main/Kconfig.projbuild
```kconfig
menu "Simple OTA Configuration"

    config WIFI_SSID
        string "WiFi SSID"
        default "myssid"
        help
            SSID (network name) for the example to connect to.

    config WIFI_PASSWORD
        string "WiFi Password"
        default "mypassword"
        help
            WiFi password (WPA or WPA2) for the example to use.

    config FIRMWARE_UPGRADE_URL
        string "Firmware upgrade URL"
        default "http://192.168.1.100:8070/firmware.bin"
        help
            URL of the firmware.bin served by your local HTTP server.

endmenu
```

## content/workshops/introduction-to-esp32-s31-security/code-examples/assignment-1/sdkconfig.defaults
```kconfig
# SPDX-FileCopyrightText: 2025 Espressif Systems (Shanghai) CO LTD
# SPDX-License-Identifier: Apache-2.0

CONFIG_IDF_TARGET="esp32s31"
CONFIG_MBEDTLS_CERTIFICATE_BUNDLE=y
CONFIG_ESPTOOLPY_FLASHSIZE_4MB=y
CONFIG_PARTITION_TABLE_SINGLE_APP_LARGE=y
```

## content/workshops/introduction-to-esp32-s31-security/code-examples/assignment-2/sdkconfig.defaults
```kconfig
# SPDX-FileCopyrightText: 2025 Espressif Systems (Shanghai) CO LTD
# SPDX-License-Identifier: Apache-2.0

CONFIG_IDF_TARGET="esp32s31"
CONFIG_MBEDTLS_CERTIFICATE_BUNDLE=y
CONFIG_ESPTOOLPY_FLASHSIZE_4MB=y
CONFIG_PARTITION_TABLE_CUSTOM=y
CONFIG_PARTITION_TABLE_CUSTOM_FILENAME="partitions.csv"
CONFIG_PARTITION_TABLE_OFFSET=0x10000
CONFIG_NVS_ENCRYPTION=y
CONFIG_NVS_SEC_KEY_PROTECT_USING_HMAC=y
CONFIG_NVS_SEC_HMAC_EFUSE_KEY_ID=0
# CONFIG_EFUSE_VIRTUAL is not set
CONFIG_EXAMPLE_CONNECT_WIFI=y
CONFIG_EXAMPLE_WIFI_SSID="myssid"
CONFIG_EXAMPLE_WIFI_PASSWORD="mypassword"
```

## content/workshops/introduction-to-esp32-s31-security/code-examples/assignment-3/sdkconfig.defaults
```kconfig
# SPDX-FileCopyrightText: 2025 Espressif Systems (Shanghai) CO LTD
# SPDX-License-Identifier: Apache-2.0

CONFIG_IDF_TARGET="esp32s31"
CONFIG_MBEDTLS_CERTIFICATE_BUNDLE=y
CONFIG_ESPTOOLPY_FLASHSIZE_4MB=y
CONFIG_PARTITION_TABLE_CUSTOM=y
CONFIG_PARTITION_TABLE_CUSTOM_FILENAME="partitions.csv"
CONFIG_PARTITION_TABLE_OFFSET=0x10000
CONFIG_EXAMPLE_CONNECT_WIFI=y
CONFIG_EXAMPLE_WIFI_SSID="myssid"
CONFIG_EXAMPLE_WIFI_PASSWORD="mypassword"
# CONFIG_NVS_ENCRYPTION is not set
# CONFIG_EFUSE_VIRTUAL is not set
CONFIG_SECURE_BOOT=y
CONFIG_SECURE_BOOT_V2_ENABLED=y
CONFIG_SECURE_SIGNED_APPS_RSA_SCHEME=y
CONFIG_SECURE_BOOT_BUILD_SIGNED_BINARIES=y
CONFIG_SECURE_BOOT_SIGNING_KEY="secure_boot_signing_key.pem"
CONFIG_SECURE_DISABLE_ROM_DL_MODE=y
```

## content/workshops/introduction-to-esp32-s31-security/code-examples/assignment-4/sdkconfig.defaults
```kconfig
# SPDX-FileCopyrightText: 2026 Espressif Systems (Shanghai) CO LTD
# SPDX-License-Identifier: Apache-2.0

CONFIG_IDF_TARGET="esp32s31"
CONFIG_ESPTOOLPY_FLASHSIZE_4MB=y
CONFIG_PARTITION_TABLE_CUSTOM=y
CONFIG_PARTITION_TABLE_CUSTOM_FILENAME="partitions.csv"
CONFIG_PARTITION_TABLE_OFFSET=0x10000

CONFIG_EXAMPLE_CONNECT_WIFI=y
CONFIG_EXAMPLE_WIFI_SSID="myssid"
CONFIG_EXAMPLE_WIFI_PASSWORD="mypassword"
CONFIG_MBEDTLS_CERTIFICATE_BUNDLE=y

CONFIG_SECURE_BOOT=y
CONFIG_SECURE_BOOT_V2_ENABLED=y
CONFIG_SECURE_SIGNED_APPS_RSA_SCHEME=y
CONFIG_SECURE_BOOT_BUILD_SIGNED_BINARIES=y
CONFIG_SECURE_BOOT_SIGNING_KEY="secure_boot_signing_key.pem"
CONFIG_SECURE_DISABLE_ROM_DL_MODE=y
CONFIG_SECURE_FLASH_ENC_ENABLED=y
CONFIG_SECURE_FLASH_ENCRYPTION_MODE_RELEASE=y

CONFIG_NVS_ENCRYPTION=y
CONFIG_NVS_SEC_KEY_PROTECT_USING_FLASH_ENC=y
# CONFIG_EFUSE_VIRTUAL is not set
```

## content/workshops/introduction-to-esp32-s31-security/code-examples/assignment-5/main/Kconfig.projbuild
```kconfig
# SPDX-FileCopyrightText: 2026 Espressif Systems (Shanghai) CO LTD
# SPDX-License-Identifier: Apache-2.0

menu "Workshop OTA"

    config WORKSHOP_OTA_URL
        string "Firmware upgrade URL"
        default "https://192.168.4.1:8070/firmware.bin"
        help
            HTTPS URL of the signed application image served by the OTA server.
            The host must match the subjectAltName in server_certs/ca_cert.pem.

    config WORKSHOP_OTA_FAIL_SELF_TEST
        bool "Simulate a failed self-test after an update"
        default n
        help
            When enabled, a freshly updated image reports a failed self-test and
            asks the bootloader to roll back to the previous image. Use it only to
            build a deliberately bad update for the rollback test.

endmenu
```

## content/workshops/introduction-to-esp32-s31-security/code-examples/lp-core-demo/main/Kconfig.projbuild
```kconfig
menu "LP-Core Pulse Counter Demo"

    config DEMO_HP_HOLD_TIME_MS
        int "HP-only measurement interval (ms)"
        range 1000 60000
        default 10000
        help
            Time to keep the HP domain running after Wi-Fi shuts down and
            before starting the LP core.

    config DEMO_PULSE_INTERVAL_MS
        int "Simulated pulse interval (ms)"
        range 10 60000
        default 1000
        help
            Time between LP timer counts and GPIO marker pulses.

    config DEMO_PULSES_PER_WAKEUP
        int "Pulses required to wake the HP core"
        range 1 1000000
        default 30
        help
            The LP core wakes the HP core after counting this many pulses.

    config DEMO_TRACE_GPIO
        int "GPIO for LP pulse tracing"
        range 0 7
        default 4
        help
            RTC GPIO driven high briefly after every LP count.
            GPIO4 is exposed as J2 pin 32 on the Function-CoreBoard-1.

    config DEMO_TRACE_PULSE_WIDTH_MS
        int "GPIO trace pulse width (ms)"
        range 1 100
        default 1
        help
            GPIO remains low between counts and goes high for this duration
            whenever an LP count occurs.

endmenu
```

## content/workshops/introduction-to-esp32-s31-security/code-examples/lp-core-demo/sdkconfig.defaults
```kconfig
CONFIG_ULP_COPROC_ENABLED=y
CONFIG_ULP_COPROC_TYPE_LP_CORE=y
CONFIG_ULP_COPROC_RESERVE_MEM=8128
CONFIG_ESPTOOLPY_FLASHSIZE_16MB=y

CONFIG_DEMO_HP_HOLD_TIME_MS=10000
CONFIG_DEMO_PULSE_INTERVAL_MS=1000
CONFIG_DEMO_PULSES_PER_WAKEUP=30
```
